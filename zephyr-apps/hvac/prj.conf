## CMakeLists.txt
```
# SPDX-License-Identifier: Apache-2.0

cmake_minimum_required(VERSION 3.20.0)

# Set board and overlay before finding Zephyr package
set(BOARD native_sim)
set(DTC_OVERLAY_FILE ${CMAKE_CURRENT_SOURCE_DIR}/boards/native_sim.overlay)

find_package(Zephyr REQUIRED HINTS $ENV{ZEPHYR_BASE})
project(hvac)

# Add include directories
include_directories(${CMAKE_CURRENT_SOURCE_DIR}/../common/net)

# Add source files
target_sources(app PRIVATE src/main.c) 
```

## Kconfig
```
# Private config options for HVAC application

# Copyright (c) 2024
# SPDX-License-Identifier: Apache-2.0

# Workaround for board config issues
config CONSOLE
    bool "Console support"
    default y
    help
      This option enables console support.

config SYS_CLOCK_HW_CYCLES_PER_SEC
    int "Hardware cycles per second"
    default 1000000
    help
      Hardware cycles per second.

config HVAC_PORT
    int "HVAC application port"
    default 5002
    help
      This option specifies the UDP port to use for the HVAC application.

# Network configuration
config AC_NET_LOG_LEVEL
    int "Log level for network module"
    default 4
    help
      Log level for network module (0-4).

source "Kconfig.zephyr" 
```

## Kconfig.defaults
```
CONFIG_CAN=y
CONFIG_CAN_SOCKETCAN=y 
```

## prj.conf
```kconfig
# General networking options
CONFIG_NETWORKING=y
CONFIG_NET_SOCKETS=y
CONFIG_POSIX_API=y
CONFIG_NET_IPV4=n
CONFIG_NET_IPV6=n
CONFIG_NET_TCP=n
CONFIG_NET_UDP=n

# Kernel options
CONFIG_MAIN_STACK_SIZE=2048
CONFIG_ENTROPY_GENERATOR=y
CONFIG_TEST_RANDOM_GENERATOR=y
CONFIG_INIT_STACKS=y

# Logging
CONFIG_LOG=y
CONFIG_NET_LOG=y
CONFIG_PRINTK=y
CONFIG_FPU=y
CONFIG_CBPRINTF_FP_SUPPORT=y

# CAN configuration
CONFIG_CAN=y
CONFIG_CAN_NATIVE_LINUX=y
CONFIG_NET_SOCKETS_CAN=y
CONFIG_CAN_INIT_PRIORITY=80
CONFIG_CAN_MAX_FILTER=5

# Disable Ethernet
CONFIG_NET_L2_ETHERNET=n
CONFIG_ETH_NATIVE_POSIX=n

# Debug logging
CONFIG_CAN_LOG_LEVEL_DBG=y

# Network buffers
CONFIG_NET_PKT_RX_COUNT=16
CONFIG_NET_PKT_TX_COUNT=16
CONFIG_NET_BUF_RX_COUNT=64
CONFIG_NET_BUF_TX_COUNT=64
CONFIG_NET_CONTEXT_NET_PKT_POOL=y

# IP address options
#CONFIG_NET_IF_UNICAST_IPV4_ADDR_COUNT=1
#CONFIG_NET_MAX_CONTEXTS=5

# Network application options and configuration
CONFIG_NET_CONFIG_SETTINGS=y
CONFIG_NET_CONFIG_NEED_IPV4=y
CONFIG_NET_CONFIG_MY_IPV4_ADDR="192.0.2.2"
CONFIG_NET_CONFIG_PEER_IPV4_ADDR="192.0.2.20"
CONFIG_NET_CONFIG_MY_IPV4_GW="192.0.2.20"
CONFIG_ETH_NATIVE_POSIX=y
CONFIG_ETH_NATIVE_POSIX_DRV_NAME="zeth0"

# HVAC application configuration
CONFIG_HVAC_PORT=5000

# Number of socket descriptors
CONFIG_ZVFS_OPEN_MAX=8
```

## boards/native_sim.overlay
```dts
/ {
    my_can: can {
        compatible = "zephyr,native-linux-can";
        label = "my_can";
        host-interface = "vcan0";
        status = "okay";
    };
}; 
```

## src/main.c
```c
/*
 * Copyright (c) 2024
 *
 * SPDX-License-Identifier: Apache-2.0
 */

#include <zephyr/kernel.h>
#include <zephyr/logging/log.h>
#include <string.h>
#include <stdio.h>
#include <math.h>
#include <zephyr/drivers/can.h>
#include <signal.h>

#include "hvac.h"
#include "can_ids.h"

LOG_MODULE_REGISTER(hvac_model, LOG_LEVEL_DBG);

struct hvac_data hvac_data;

/* Work items for periodic updates */
static struct k_work_delayable temp_calc_work;
static struct k_work_delayable status_work;
static const struct device *can_dev;

/* Flag to indicate shutdown requested */
static volatile sig_atomic_t running = 1;

/* Signal handler */
static void signal_handler(int sig)
{
    LOG_INF("Signal %d received, shutting down...", sig);
    running = 0;
}

/* CAN standard ID mask if not defined */
#ifndef CAN_STD_ID_MASK
#define CAN_STD_ID_MASK     0x7FF
#endif

static void send_can_message(uint32_t id, uint8_t *msg_data, size_t len)
{
    struct can_frame frame;
    int ret;

    /* Prepare CAN frame */
    frame.id = id & CAN_STD_ID_MASK;  /* Ensure ID is within standard CAN range */
    frame.flags = 0;                   /* Standard CAN frame */
    frame.dlc = len > CAN_MAX_DLC ? CAN_MAX_DLC : len;
    memcpy(frame.data, msg_data, frame.dlc);

    /* Send frame */
    ret = can_send(can_dev, &frame, K_MSEC(100), NULL, NULL);
    if (ret != 0) {
        LOG_ERR("Failed to send CAN frame (err %d)", ret);
    } else {
        LOG_DBG("Sent CAN frame ID 0x%x, len %d", id, frame.dlc);
    }
}

/* Send status update via CAN */
static void send_status_update(void)
{
    uint8_t data[8] = {
        (uint8_t)(hvac_data.cabin_temp * 2),    // Current temp * 2
        (uint8_t)(hvac_data.external_temp * 2), // External temp * 2
        hvac_data.ac_on,                        // AC power state
        hvac_data.fan_speed,                    // Fan speed
        0, 0, 0, 0                              // Reserved
    };
    
    send_can_message(HVAC_STATUS_ID, data, sizeof(data));
    
    LOG_INF("Status - Cabin: %.1f°C, External: %.1f°C, AC: %d, Fan: %d",
            (double)hvac_data.cabin_temp,
            (double)hvac_data.external_temp,
            hvac_data.ac_on,
            hvac_data.fan_speed);
}

/* CAN receiver callback */
static void can_receiver_thread(const struct device *dev, struct can_frame *frame, void *user_data)
{
    ARG_UNUSED(dev);
    ARG_UNUSED(user_data);

    /* Print detailed CAN frame information */
    LOG_DBG("Received CAN frame:");
    LOG_DBG("  ID: 0x%x", frame->id);
    LOG_DBG("  Flags: 0x%x", frame->flags);
    LOG_DBG("  DLC: %d", frame->dlc);
    LOG_DBG("  Data: [%d, %d, %d]", frame->data[0], frame->data[1], frame->data[2]);

    /* Handle messages from ac_panel (AC Control GUI) */
    if (frame->id == HVAC_AC_STATUS_ID) {  // AC status ID
        hvac_data.ac_on = frame->data[0];
        hvac_data.fan_speed = frame->data[1];
        // mode is in frame->data[2] but not used by hvac model
        
        LOG_INF("Received AC status - Power: %d, Fan: %d",
                hvac_data.ac_on,
                hvac_data.fan_speed);
    }
    else if (frame->id == HVAC_POWER_STATUS_ID) {  // Power status ID
        hvac_data.ac_on = frame->data[0];
        
        LOG_INF("Received AC power - State: %d",
                hvac_data.ac_on);
    }
    else if (frame->id == HVAC_CONTROL_ID) {  // Legacy AC control message
        hvac_data.ac_on = frame->data[0];
        hvac_data.target_temp = (float)frame->data[1] / 2.0f;
        hvac_data.fan_speed = frame->data[2];
        
        LOG_INF("Received legacy AC control - Power: %d, Target: %.1f°C, Fan: %d",
                hvac_data.ac_on,
                (double)hvac_data.target_temp,
                hvac_data.fan_speed);
    }
}

static void setup_can(void)
{
    /* Get CAN device */
    can_dev = device_get_binding("my_can");
    if (!can_dev) {
        LOG_ERR("Failed to get CAN device binding");
        return;
    }
    
    if (!device_is_ready(can_dev)) {
        LOG_ERR("CAN device is not ready");
        return;
    }

    /* Start CAN device */
    int ret = can_start(can_dev);
    if (ret != 0) {
        LOG_ERR("Failed to start CAN device (err %d)", ret);
        return;
    }

    // Add a filter for standard CAN IDs
    struct can_filter std_filter = {
        .id = 0,    // Match any standard ID
        .mask = 0,  // Don't care about any bits
        .flags = 0  // This is a filter for standard IDs
    };

    LOG_INF("Attaching CAN RX filter for all standard messages.");
    ret = can_add_rx_filter(can_dev, can_receiver_thread, NULL, &std_filter);
    if (ret < 0) {
        LOG_ERR("Failed to add standard CAN RX filter (err %d). May not receive standard CAN messages.", ret);
        // Optionally return here if this is critical
    }

    // Add a filter for extended CAN IDs
    struct can_filter ext_filter = {
        .id = 0,    // Match any extended ID
        .mask = 0,  // Don't care about any bits
        .flags = CAN_FILTER_IDE // This is a filter for extended IDs
    };

    LOG_INF("Attaching CAN RX filter for all extended messages.");
    ret = can_add_rx_filter(can_dev, can_receiver_thread, NULL, &ext_filter);
    if (ret < 0) {
        LOG_ERR("Failed to add extended CAN RX filter (err %d). May not receive extended CAN messages.", ret);
        // Optionally return here if this is critical
    }
    
    LOG_INF("CAN setup complete, listening for all messages via two filters.");
}

/* Status update work handler */
static void status_update(struct k_work *work)
{
    /* Send status update */
    send_status_update();

    /* Schedule next update (2 second interval) */
    k_work_schedule(&status_work, K_MSEC(2000));
}

/* Temperature calculation work handler */
static void calculate_temperature(struct k_work *work)
{
    if (hvac_data.ac_on) {
        // If AC is on but no target temp is set, use default cooling temp
        if (hvac_data.target_temp == AMBIENT_TEMP) {
            hvac_data.target_temp = AMBIENT_TEMP - 3.0f; // Default cooling target
            LOG_INF("Using default cooling target: %.1f°C", (double)hvac_data.target_temp);
        }
        
        // Calculate heat transfer
        float temp_diff = hvac_data.target_temp - hvac_data.cabin_temp;
        // Use fan speed with the enhanced coefficient from hvac.h
        float cooling_power = hvac_data.fan_speed * HEAT_TRANSFER_COEFF;
        
        // Simple hvac model
        float heat_flow = cooling_power * temp_diff;
        float cabin_temp_change = heat_flow / HVAC_MASS;
        
        LOG_DBG("AC calculation: diff=%.2f, power=%.2f, flow=%.4f, change=%.4f°C",
                (double)temp_diff, (double)cooling_power, (double)heat_flow, (double)cabin_temp_change);
        
        hvac_data.cabin_temp += cabin_temp_change;
        
        // Reduced external heat influence when AC is on (AC recirculates internal air)
        // Modern cars with AC on reduce outside air influence significantly
        float external_factor = 0.003f; // Further reduced external influence when AC is on
        float external_influence = (hvac_data.external_temp - hvac_data.cabin_temp) * external_factor;
        hvac_data.cabin_temp += external_influence;
        
        LOG_DBG("External influence: %.4f°C", (double)external_influence);
    } else {
        // When AC is off, cabin temperature slowly approaches external temperature
        // Higher rate when AC is off (windows might be open, normal air exchange)
        float temp_change = (hvac_data.external_temp - hvac_data.cabin_temp) * 0.03f;
        hvac_data.cabin_temp += temp_change;
        LOG_DBG("AC off: cabin temp changing by %.4f°C toward external", (double)temp_change);
    }
    
    // Log current state
    LOG_INF("Thermal - Cabin: %.1f°C, Target: %.1f°C, External: %.1f°C",
            (double)hvac_data.cabin_temp,
            (double)hvac_data.target_temp,
            (double)hvac_data.external_temp);
            
    // Schedule next update
    k_work_schedule(&temp_calc_work, K_MSEC(1000));
}

void start_ac_ecu(void)
{
    // Initialize hvac data
    memset(&hvac_data, 0, sizeof(hvac_data));
    hvac_data.cabin_temp = AMBIENT_TEMP;
    hvac_data.target_temp = AMBIENT_TEMP;
    hvac_data.fan_speed = 1;
    hvac_data.ac_on = false;
    hvac_data.external_temp = AMBIENT_TEMP + 5.0f;  // Slightly warmer outside
    hvac_data.initialized = true;

    // Setup CAN
    setup_can();

    // Initialize work queues
    k_work_init_delayable(&temp_calc_work, calculate_temperature);
    k_work_init_delayable(&status_work, status_update);
    
    // Start periodic updates
    k_work_schedule(&temp_calc_work, K_MSEC(1000));  // Temperature updates every 1 second
    k_work_schedule(&status_work, K_MSEC(2000));     // Status updates every 2 seconds

    // Send initial status update
    send_status_update();
}

void stop_hvac(void)
{
    // Clean up resources
    k_work_cancel_delayable(&temp_calc_work);
    k_work_cancel_delayable(&status_work);
    if (can_dev) {
        can_stop(can_dev);
    }
    LOG_INF("HVAC ECU Application stopped successfully");
}

int main(void)
{
    LOG_INF("HVAC ECU Application");

    /* Set up signal handling */
    signal(SIGINT, signal_handler);
    signal(SIGTERM, signal_handler);

    start_ac_ecu();
    
    /* Main loop - wait for signal to exit */
    while (running) {
        k_sleep(K_MSEC(100));
    }
    
    /* Clean shutdown */
    LOG_INF("HVAC ECU Application preparing to shutdown...");
    stop_hvac();
    
    return 0;
} 
```

## src/common.h
```c
/*
 * Copyright (c) 2024
 *
 * SPDX-License-Identifier: Apache-2.0
 */

#ifndef COMMON_H
#define COMMON_H

#include <zephyr/kernel.h>
#include <zephyr/net/socket.h>
#include <zephyr/net/net_ip.h>

#define MY_PORT CONFIG_HVAC_PORT
#if defined(CONFIG_NET_SOCKETS_SOCKOPT_TLS) || defined(CONFIG_NET_TCP) || \
    defined(CONFIG_COVERAGE_GCOV)
#define STACK_SIZE 4096
#else
#define STACK_SIZE 2048
#endif

#if defined(CONFIG_NET_TC_THREAD_COOPERATIVE)
#define THREAD_PRIORITY K_PRIO_COOP(CONFIG_NUM_COOP_PRIORITIES - 1)
#else
#define THREAD_PRIORITY K_PRIO_PREEMPT(8)
#endif

#define MAX_MSG_SIZE 256
#define STATS_TIMER 60 /* How often to print statistics (in seconds) */

/* Thermal model parameters */
#define AMBIENT_TEMP 25.0f
#define HVAC_MASS 100.0f
#define HEAT_TRANSFER_COEFF 0.1f

#if defined(CONFIG_USERSPACE)
#include <zephyr/app_memory/app_memdomain.h>
extern struct k_mem_partition app_partition;
extern struct k_mem_domain app_domain;
#define APP_BMEM K_APP_BMEM(app_partition)
#define APP_DMEM K_APP_DMEM(app_partition)
#else
#define APP_BMEM
#define APP_DMEM
#endif

struct hvac_data {
    int sock;
    char recv_buffer[MAX_MSG_SIZE];
    uint32_t counter;
    atomic_t bytes_received;
    struct k_work_delayable stats_print;
    bool connected;
    
    /* Thermal model state */
    float cabin_temp;     // Current cabin temperature
    float target_temp;    // Target temperature from AC
    uint8_t fan_speed;    // Current fan speed
    bool ac_power;        // AC power state
    float external_temp;  // External temperature (simulated)
};

extern struct hvac_data hvac_data;

/* Thread stack and data */
K_THREAD_STACK_DEFINE(hvac_stack, STACK_SIZE);
extern struct k_thread hvac_thread_data;

void start_hvac(void);
void stop_hvac(void);

#endif /* COMMON_H */ 
```

## src/hvac.h
```c
#ifndef HVAC_H_
#define HVAC_H_

#include <zephyr/kernel.h>
#include <stdbool.h>
#include <stdint.h>

/* Thermal model parameters */
#define AMBIENT_TEMP_MIN -20
#define AMBIENT_TEMP_MAX 50
#define AC_COOLING_FACTOR 0.05f
#define AMBIENT_WARMING_FACTOR 0.01f

/* Thermal model parameters */
#define AMBIENT_TEMP 25.0f
#define HVAC_MASS 50.0f
#define HEAT_TRANSFER_COEFF 0.1f

struct hvac_data {
    /* Thermal model parameters */
    float cabin_temp;
    float target_temp;
    float external_temp;
    bool ac_on;
    uint8_t fan_speed;
    bool initialized;
};

extern struct hvac_data hvac_data;

/* Thread stack */
K_THREAD_STACK_DEFINE(hvac_stack, CONFIG_MAIN_STACK_SIZE);

void start_ac_ecu(void);
void stop_hvac(void);

#endif /* HVAC_H_ */ 
```
